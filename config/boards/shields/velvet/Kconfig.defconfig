## config/boards/shields/velvet/Kconfig.defconfig
```kconfig
if SHIELD_VELVET_LEFT 

config ZMK_KEYBOARD_NAME
    default "velvet Left"

config ZMK_SPLIT_BLE_ROLE_CENTRAL
    default y

endif

if SHIELD_VELVET_RIGHT

config ZMK_KEYBOARD_NAME
    default "velvet Right"

endif

if SHIELD_VELVET

config ZMK_SPLIT
    default y

endif
```

## config/boards/shields/velvet/Kconfig.shield
```kconfig
config SHIELD_VELVET
    bool

config SHIELD_VELVET_LEFT
    def_bool $(shields_list_contains,velvet_left)
        select SHIELD_VELVET

config SHIELD_VELVET_RIGHT
    def_bool $(shields_list_contains,velvet_right)
        select SHIELD_VELVET
```
